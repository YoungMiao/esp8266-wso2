/**
 * Helloworld style, connect an ESP8266 to the IBM IoT Foundation
 * 
 * Author: Ant Elder
 * License: Apache License v2
 */
#include <ESP8266WiFi.h>
#include <PubSubClient.h> // https://github.com/knolleary/pubsubclient/releases/tag/v2.3

//-------- Customise these values -----------
const char* ssid = "maple";
const char* password = "12345678";

#define ORG "dyob0d"
#define DEVICE_TYPE "ESP8266"
#define DEVICE_ID "Test3"
#define TOKEN "@maple123456"
#define pin 4

//-------- Customise the above values --------

char server[] = ORG ".messaging.internetofthings.ibmcloud.com";
char topic[] = "iot-2/evt/status/fmt/json";
char authMethod[] = "use-token-auth";
char token[] = TOKEN;
char clientId[] = "d:" ORG ":" DEVICE_TYPE ":" DEVICE_ID;

char topicpb[] = "iot-2/evt/status/fmt/json";
char topicmd[] = "iot-2/cmd/+/fmt/json" ; //Topic for subscribing commands;

//--------- CA define -----------
unsigned char certificates_esp8266_bin_key[] ={
  0x30, 0x82, 0x04, 0xa5, 0x02, 0x01, 0x00, 0x02, 0x82, 0x01, 0x01, 0x00,
  0xcf, 0xdc, 0xa9, 0x45, 0x56, 0x59, 0x6e, 0x02, 0x0c, 0xd0, 0x44, 0xc5,
  0xef, 0x23, 0x3c, 0x81, 0x0d, 0xc7, 0xf0, 0x44, 0x18, 0x7f, 0xa7, 0x48,
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  0x84, 0x48, 0x78, 0xae, 0x0f
};
unsigned int certificates_esp8266_bin_key_len = 1193;
unsigned char certificates_esp8266_bin_crt[] = {
  0x30, 0x82, 0x03, 0xdf, 0x30, 0x82, 0x02, 0xc7, 0xa0, 0x03, 0x02, 0x01,
  0x02, 0x02, 0x09, 0x00, 0xcf, 0x46, 0xb9, 0xd3, 0xe7, 0x6b, 0x77, 0xd8,
  0x30, 0x0d, 0x06, 0x09, 0x2a, 0x86, 0x48, 0x86, 0xf7, 0x0d, 0x01, 0x01,
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  0x28, 0x8e, 0xc0, 0xbc, 0x36, 0xfe, 0x91, 0x9d, 0x8b, 0xae, 0x3a
};
unsigned int certificates_esp8266_bin_crt_len = 995;

void callback(char* topic, byte* payload, unsigned int length) {
  Serial.print("Message arrived [");
  Serial.print(topic);
  Serial.print("] ");
  for (int i = 0; i < length; i++)
    Serial.print((char)payload[i]);

  Serial.println();
}

WiFiClientSecure wifiClient;
PubSubClient client(server, 8883, callback, wifiClient);

void setup() {
 Serial.begin(115200);
 Serial.println();

 Serial.print("Connecting to "); Serial.print(ssid);
 WiFi.begin(ssid, password);
 while (WiFi.status() != WL_CONNECTED) {
    delay(500);
    Serial.print("1.");
 } 
 Serial.println("2");
 Serial.print("WiFi connected, IP address: "); Serial.println(WiFi.localIP());
 wifiClient.setCertificate(certificates_esp8266_bin_crt, certificates_esp8266_bin_crt_len);
 wifiClient.setPrivateKey(certificates_esp8266_bin_key, certificates_esp8266_bin_key_len);
 //wifiClient.setCACert(certificates_esp8266_bin_CA, certificates_esp8266_bin_CA_len);
}

int counter = 0;

void loop() {
 if (!!!client.connected()) {
   Serial.print("Reconnecting client to ");
   Serial.println(server);
   while (!!!client.connect(clientId, authMethod, token)) {
      Serial.print("3.");
      delay(500);
   }
   Serial.println();
 }
// --------- get dht11 data -------------
status,temp,humi,temp_decimal,humi_decimal = dht.read11(pin);

if (status == dht.OK){
  String payload = "{\"d\":{\"Temperature\":";
  payload += temp;
  payload += ",\"Humidity\":";
  payload += humi;
  payload += ",\"counter\":";
  payload += counter;
  payload += "}}";
  if (client.publish(topic, (char*) payload.c_str())) {
    Serial.println("Publish ok");
    } 
  else {
    Serial.println("Publish failed");
    }
  }
 
 Serial.print("Sending payload: ");
 Serial.println(payload);
 
 if (client.publish(topic, (char*) payload.c_str())) {
   Serial.println("Publish ok");
 } else {
   Serial.println("Publish failed");
 }

 ++counter;
 delay(10000);
}
